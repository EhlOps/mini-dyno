## firmware/components/hall_sensor/Kconfig.projbuild
```kconfig
menu "Hall Effect Sensor"

    config HALL_SENSOR_DEFAULT_GPIO
        int "Default GPIO for Hall sensor input"
        default 10
        range 0 21
        help
            GPIO pin connected to the Hall effect sensor output.
            The pin is configured as an input with an internal pull-up.

    config HALL_SENSOR_PULSES_PER_REV
        int "Pulses per revolution"
        default 4
        range 1 32
        help
            Number of magnets (pulses) per full revolution of the rotor.
            Set this to match the number of magnets mounted on the water brake.

endmenu
```

## firmware/components/hx711/Kconfig.projbuild
```kconfig
menu "HX711 Load Cell ADC"

    config HX711_DEFAULT_CLK_GPIO
        int "Default PD_SCK GPIO number"
        default 4
        range 0 48
        help
            GPIO number connected to the HX711 PD_SCK (clock) pin.
            Can be overridden at runtime via hx711_config_t.clk_gpio.

    config HX711_DEFAULT_DATA_GPIO
        int "Default DOUT GPIO number"
        default 5
        range 0 48
        help
            GPIO number connected to the HX711 DOUT (data) pin.
            Can be overridden at runtime via hx711_config_t.data_gpio.

    choice HX711_DEFAULT_GAIN
        prompt "Default channel / gain selection"
        default HX711_DEFAULT_GAIN_A_128
        help
            Selects the input channel and PGA gain used after initialisation.
            Channel A supports gains of 64 or 128; Channel B supports gain 32.

        config HX711_DEFAULT_GAIN_A_128
            bool "Channel A, gain 128 (highest sensitivity)"
        config HX711_DEFAULT_GAIN_B_32
            bool "Channel B, gain 32"
        config HX711_DEFAULT_GAIN_A_64
            bool "Channel A, gain 64"
    endchoice

endmenu
```

## firmware/components/wifi_ap/Kconfig.projbuild
```kconfig
menu "WiFi AP / WebSocket Server"

    config WIFI_AP_SSID
        string "Access Point SSID"
        default "mini-dyno"
        help
            The SSID that the ESP32-C3 will broadcast. Mobile devices connect to this.

    config WIFI_AP_PASSWORD
        string "Access Point Password"
        default ""
        help
            WPA2 password. Leave empty for an open (no-password) network.

    config WIFI_AP_CHANNEL
        int "WiFi Channel"
        default 1
        range 1 13

    config WIFI_AP_MAX_CLIENTS
        int "Maximum simultaneous stations"
        default 4
        range 1 8

endmenu
```

## firmware/sdkconfig.defaults
```kconfig
# WebSocket support in esp_http_server (required for /ws endpoint)
CONFIG_HTTPD_WS_SUPPORT=y
```
